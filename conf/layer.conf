## conf/layer.conf
```bitbake
# We have a conf and classes directory, add to BBPATH
BBPATH .= ":${LAYERDIR}"

# We have a packages directory, add to BBFILES
BBFILES += "${LAYERDIR}/recipes-*/*/*.bb \
            ${LAYERDIR}/recipes-*/*/*.bbappend"

PREFERRED_PROVIDER_virtual/kernel = "linux-kernel-qcom-rt"
BBFILE_COLLECTIONS      += "qcom-realtime"
BBFILE_PATTERN_qcom-realtime   = "^${LAYERDIR}/"
BBFILE_PRIORITY_qcom-realtime  = "12"
LAYERSERIES_COMPAT_qcom-realtime = "kirkstone"
```
